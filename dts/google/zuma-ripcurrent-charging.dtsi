// SPDX-License-Identifier: GPL-2.0-only
/*
 * Battery device tree entries specific to ripcurrent
 *
 * Copyright 2022 Google LLC
 *
 */

#include "../google-dts-base/zuma-charging.dtsi"

&pinctrl_0 {

	dc_charger_irq: dc-charger-irq {
		samsung,pins = "gpa7-4"; /* XEINT_18 (PLC_INT_L) */
		samsung,pin-function = <EXYNOS_PIN_FUNC_EINT>;
		samsung,pin-pud = <EXYNOS_PIN_PULL_UP>;
	};
};

&hsi2c_11 {

	#address-cells = <1>;
	#size-cells = <0>;
	status = "okay";
	clock-frequency = <400000>;

	#include "../google-dts-base/zuma-charge-pumps.dtsi"
};

&google_cpm {
	/* S2MPG12X01 -> GPIO_1 -> CHARGE_PUMP_EN */
	google,dc-en = <&s2mpg14_gpio 1 0>;
	/* DC enabled by default */
	google,dc-en-value = <1>;
};
